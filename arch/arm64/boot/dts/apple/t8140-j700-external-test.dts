// SPDX-License-Identifier: GPL-2.0+ OR MIT
/* Explicit external-display trial; the ordinary J700 tree is unchanged. */
#include "t8140-j700.dts"
#include <dt-bindings/phy/phy.h>

&display {
	iommus = <&disp0_dart 0>, <&dispext0_dart 0>;
};

&dcpext {
	clocks = <&clk_disp0_154>, <&clk_disp0_194>;
	clock-names = "clock-154", "clock-194";
	phys = <&atcphy0 PHY_TYPE_DP>;
	phy-names = "typec0";
	mux-controls = <&dpxbar0 0>;
	mux-control-names = "typec0";
	apple,typec-mux-indices = <0>;
	apple,typec-dptx-phys = <0>;
	apple,dcp-index = <1>;
};

&{/soc/dcp@416e00000/typec-routes/route@0} {
	status = "okay";
};
