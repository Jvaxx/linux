## drivers/gpu/drm/apple/Kconfig
```kconfig
# SPDX-License-Identifier: GPL-2.0-only OR MIT
config DRM_APPLE
	tristate "DRM Support for Apple display controllers"
	depends on DRM && OF && ARM64
	depends on ARCH_APPLE || COMPILE_TEST
	depends on APPLE_RTKIT
	depends on OF_ADDRESS
	select APPLE_PMP_REPORT
	select DRM_CLIENT_SELECTION
	select DRM_KMS_HELPER
	select DRM_KMS_DMA_HELPER
	select DRM_GEM_DMA_HELPER
	select VIDEOMODE_HELPERS
	depends on BACKLIGHT_CLASS_DEVICE
	select MULTIPLEXER
	help
	  Say Y if you have an Apple Silicon chipset.

config DRM_APPLE_AUDIO
	bool "DisplayPort/HDMI Audio support"
	default y
	depends on DRM_APPLE
	depends on SND
	select SND_PCM
	select SND_DMAENGINE_PCM

config DRM_APPLE_DEBUG
	bool "Enable additional driver debugging"
	depends on DRM_APPLE
	depends on EXPERT # only for developers

config DRM_APPLE_KUNIT_TEST
	tristate "KUnit tests for Apple display controller" if !KUNIT_ALL_TESTS
	depends on KUNIT
	select DRM_KUNIT_TEST_HELPERS if DRM_APPLE
	default KUNIT_ALL_TESTS
	help
	  Build tests for the Apple display driver's AFK ring parser and
	  backlight policy (takeover, DPMS, suspend, fades and present
	  completion).
	  The tests cover the header strides used by older firmware and
	  larger rings, as well as malformed ring size combinations.
	  This option is intended for developer test kernels.
	  Also test the Type-C modeset, hotplug and service ownership state,
	  the system resume of a CRTC whose mode is no longer admissible, and
	  when an external display is ready to be reported to userspace.

config DRM_APPLE_PARSER_KUNIT_TEST
	bool "KUnit tests for Apple firmware message parsers" if !KUNIT_ALL_TESTS
	depends on DRM_APPLE && KUNIT=y
	default KUNIT_ALL_TESTS
	help
	  Build tests for AFKv2 lengths, DMA ownership and reply correlation,
	  legacy EPIC replies, and H17P IOMFB callback envelopes and sizes.
	  The tests use allocated buffers and fake devices and do not require
	  an Apple display controller or any firmware.
```

## drivers/net/wireless/mediatek/mt7932/Kconfig
```kconfig
# SPDX-License-Identifier: GPL-2.0-only
config MT7932_FULLMAC
	tristate "Experimental J700 MT7932 fullmac wireless support"
	depends on PCI && OF && ARM64 && ARCH_APPLE && IOMMU_DMA
	depends on PCIE_APPLE_PIODMA_DIAG && CFG80211
	select FW_LOADER
	help
	  Native support for the built-in J700 Wi-Fi endpoint: managed
	  open-network or WPA2-CCMP station operation on 2.4 GHz at 20 MHz and channels 36..48
	  at 20/40/80 MHz, with a software bandwidth limit of 80 MHz.
	  Requires original firmware, own calibration and original-derived
	  country policy packages in addition to the cfg80211 regulatory database.
	  Requires a trained retained PCI link and a translated SID1 DMA domain.
	  Firmware, runtime DMA and calibration negotiation start automatically;
	  cfg80211 and userspace select the country and network. No test boot
	  parameters are required for ordinary station operation.
	  Module removal stops host users and performs a checked PCI function
	  reset before releasing DMA storage. A failed reset blocks removal,
	  retaining resources until an explicit retry succeeds or system reset.
	  Other MediaTek devices and other machines are not matched.

config MT7932_RF_KUNIT_TEST
	bool "KUnit tests for MT7932 terminal RF failure" if !KUNIT_ALL_TESTS
	depends on KUNIT=y && MT7932_FULLMAC
	default KUNIT_ALL_TESTS
	help
	  Exercise the driver's terminal calibration failure and startup
	  admission paths with synthetic devices, without radio hardware.
	  Check association wakeups, retained peer ownership and refusal to
	  reopen RF admission after a terminal calibration error.
```
